## defconfig
```kconfig
CONFIG_USE_OPTION_TABLE=y
CONFIG_BOOTSPLASH_IMAGE=y
CONFIG_BOOTSPLASH_FILE="../darp6/boot-darp6.jpg"
CONFIG_VENDOR_SYSTEM76=y
CONFIG_NO_POST=y
CONFIG_CBFS_SIZE=0xA00000
CONFIG_IFD_BIN_PATH="../darp6/fd.rom"
CONFIG_ME_BIN_PATH="../darp6/me.rom"
CONFIG_CONSOLE_CBMEM_BUFFER_SIZE=0x20000
# CONFIG_CONSOLE_SERIAL is not set
CONFIG_USE_LEGACY_8254_TIMER=y
CONFIG_HAVE_IFD_BIN=y
CONFIG_PCIEXP_HOTPLUG_BUSES=32
CONFIG_PCIEXP_HOTPLUG_MEM=0x2000000
CONFIG_PCIEXP_HOTPLUG_PREFETCH_MEM=0x20000000
CONFIG_BOARD_SYSTEM76_DARP6=y
CONFIG_UART_PCI_ADDR=0x0
CONFIG_VALIDATE_INTEL_DESCRIPTOR=y
CONFIG_HAVE_ME_BIN=y
CONFIG_BOOTSPLASH=y
CONFIG_PCIEXP_HOTPLUG_IO=0x2000
CONFIG_SUBSYSTEM_VENDOR_ID=0x1558
CONFIG_SUBSYSTEM_DEVICE_ID=0x1404
CONFIG_SMMSTORE=y
CONFIG_SMMSTORE_SIZE=0x40000
CONFIG_USE_PC_CMOS_ALTCENTURY=y
CONFIG_TPM_MEASURED_BOOT=y
CONFIG_PAYLOAD_LINUXBOOT=y
CONFIG_LINUXBOOT_COMPILE_KERNEL=y
CONFIG_LINUXBOOT_KERNEL_CUSTOM_CONFIG=y
CONFIG_LINUXBOOT_KERNEL_CONFIGFILE="../../../linux-defconfig"
CONFIG_LINUXBOOT_BUILD_INITRAMFS=y
CONFIG_LINUXBOOT_UROOT_COMMANDS="boot coreboot-app github.com/u-root/u-root/cmds/core/mkdir github.com/u-root/u-root/cmds/core/blkid github.com/u-root/u-root/cmds/core/hexdump github.com/u-root/u-root/cmds/core/gzip github.com/u-root/u-root/cmds/core/md5sum github.com/u-root/u-root/cmds/core/shasum github.com/u-root/u-root/cmds/core/umount github.com/u-root/u-root/cmds/core/more github.com/u-root/u-root/cmds/core/kexec"
```
